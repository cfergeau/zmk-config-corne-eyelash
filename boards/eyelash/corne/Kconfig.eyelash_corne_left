## boards/eyelash/corne/Kconfig.eyelash_corne_left
```kconfig
#
# Copyright (c) 2024 The ZMK Contributors
# SPDX-License-Identifier: MIT
#

config BOARD_EYELASH_CORNE_LEFT
    select SOC_NRF52840_QIAA
```

## boards/eyelash/corne/Kconfig.eyelash_corne_right
```kconfig
#
# Copyright (c) 2024 The ZMK Contributors
# SPDX-License-Identifier: MIT
#

config BOARD_EYELASH_CORNE_RIGHT
    select SOC_NRF52840_QIAA
```

## boards/eyelash/corne/board.yml
```yaml
boards:
  - name: eyelash_corne_left
    vendor: eyelash
    socs:
      - name: nrf52840
        variants:
          - name: zmk
  - name: eyelash_corne_right
    vendor: eyelash
    socs:
      - name: nrf52840
        variants:
          - name: zmk
```

## config/west.yml
```yaml
manifest:
  remotes:
    - name: zmkfirmware
      url-base: https://github.com/zmkfirmware
    - name: keebs34
      url-base: https://github.com/keebs34
      # Additional modules containing boards/shields/custom code can be listed here as well.
      # See:
      # - https://zmk.dev/docs/features/modules
      # - https://docs.zephyrproject.org/3.5.0/develop/west/manifest.html#projects
  projects:
    - name: zmk
      remote: zmkfirmware
      revision: v0.3-branch
      import: app/west.yml
    - name: zmk-config-selenium
      remote: keebs34
      revision: main
  self:
    path: config
```
